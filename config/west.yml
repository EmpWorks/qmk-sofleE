## config/west.yml
```yaml
manifest:
  remotes:
    - name: EmpWorks
      url-base: https://github.com/EmpWorks
  projects:
  - name: zmk
      remote: EmpWorks
      revision: remap-with-mouse
      import: app/west.yml
      
    - name: zmk-lpm009m360a-driver
      remote: EmpWorks
      revision: master
      
  self:
    path: config
```
